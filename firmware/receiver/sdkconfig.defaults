## firmware/receiver/sdkconfig.defaults
```kconfig
# sdkconfig.defaults for csi_receiver
# Delete build/ and sdkconfig to re-apply after editing.

# ── Partition table ──────────────────────────────────────────────────────────
CONFIG_PARTITION_TABLE_OFFSET=0xa000

# ── Wi-Fi ────────────────────────────────────────────────────────────────────
# MANDATORY: enables CSI collection in the Espressif Wi-Fi driver.
CONFIG_ESP_WIFI_CSI_ENABLED=y

# Disable RX AMPDU – aggregation corrupts per-packet CSI timestamps.
CONFIG_ESP_WIFI_AMPDU_RX_ENABLED=n

# Large RX ring buffer so we never drop a CSI report.
CONFIG_ESP_WIFI_DYNAMIC_RX_BUFFER_NUM=64

# ── FreeRTOS ─────────────────────────────────────────────────────────────────
# 1 kHz tick → 1 ms resolution (important for accurate timestamps).
CONFIG_FREERTOS_HZ=1000

# ── Serial / UART ────────────────────────────────────────────────────────────
# Larger UART TX buffer so CSV rows are never silently dropped.
CONFIG_ESP_CONSOLE_UART_BAUDRATE=115200

# ── Logging ──────────────────────────────────────────────────────────────────
CONFIG_LOG_DEFAULT_LEVEL_INFO=y
```

## firmware/transmitter/sdkconfig.defaults
```kconfig
# sdkconfig.defaults for csi_transmitter
# These settings are applied on first build (before menuconfig).
# Delete build/ and sdkconfig to re-apply after editing this file.

# ── Partition table ──────────────────────────────────────────────────────────
# Move the partition table to avoid overlap with the bootloader on ESP32.
CONFIG_PARTITION_TABLE_OFFSET=0xa000

# ── Wi-Fi ────────────────────────────────────────────────────────────────────
# Large TX buffer so bursts of ESP-NOW frames don't drop.
CONFIG_ESP_WIFI_DYNAMIC_TX_BUFFER_NUM=128

# Enable CSI feature in the Wi-Fi driver (MANDATORY for both TX and RX sides).
CONFIG_ESP_WIFI_CSI_ENABLED=y

# Disable TX AMPDU – AMPDU aggregation can corrupt CSI timing.
CONFIG_ESP_WIFI_AMPDU_TX_ENABLED=n

# ── FreeRTOS ─────────────────────────────────────────────────────────────────
# 1 kHz tick rate gives us 1 ms resolution for timing.
CONFIG_FREERTOS_HZ=1000

# ── Logging ──────────────────────────────────────────────────────────────────
# Keep INFO level so you can see the startup banner over serial.
CONFIG_LOG_DEFAULT_LEVEL_INFO=y
```
